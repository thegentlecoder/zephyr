## dts/bindings/auxdisplay/st,slcd.yaml
```yaml
#
# Copyright (c) 2026 Renato Mauro
#
# SPDX-License-Identifier: Apache-2.0
#

description:
  STMicroelectronics MCU Segment LCD (SLCD) controller used as segment-style
  auxiliary display.

compatible: "st,slcd"

include: [base.yaml, pinctrl-device.yaml]

properties:
  reg:
    required: true
    description: Base address and length of the LCD peripheral register block.

  lcd-duty:
    required: true
    type: int
    description: LCD_DUTY_1_4.

  lcd-bias:
    required: true
    type: int
    description: LCD_BIAS_1_3.

  lcd-mux-segment:
    required: true
    type: int
    description: LCD_MUXSEGMENT_DISABLE.

  lcd-voltage-source:
    type: int
    description: LCD_VOLTAGESOURCE_INTERNAL.

  lcd-prescaler:
    type: int
    description: LCD_PRESCALER_1.

  lcd-divider:
    type: int
    description: LCD_DIVIDER_31.

  lcd-contrast:
    type: int
    description: LCD_CONTRASTLEVEL_5.

  lcd-pulse-on-duration:
    type: int
    description: LCD_PULSEONDURATION_4.

  lcd-dead-time:
    type: int
    description: LCD_DEADTIME_0.

  lcd-high-drive:
    type: int
    description: LCD_HIGHDRIVE_DISABLE.

  lcd-blink-mode:
    type: int
    description: LCD_BLINKMODE_OFF.

  lcd-blink-frequency:
    type: int
    description: LCD_BLINKFREQUENCY_DIV32.

  pin-list:
    type: array
    description: |
      The list of MCU AF11 channel names associated to the corresponding LCD segment pin.

  com-list:
    type: array
    description: |
      Used just to have the count of the COM registers, not used to directly evaluate the COM
      register index.

  character-bit-list:
    type: array
    description: |
      The list of bits of the controller registers that are used to control the segments.

  character-com-list:
    type: array
    description: |
      The list of com registers of the controller that are used to control the segments.

  indicator-bit-list:
    type: array
    description: |
      The list of bits of the controller registers that are used to control the indicators.

  indicator-com-list:
    type: array
    description: |
      The list of com registers of the controller that are used to control the indicators.

  custom-character-slot-count:
    type: int
    default: 32
    description: |
      Number of custom characters the application can store into the driver and then use.
```
