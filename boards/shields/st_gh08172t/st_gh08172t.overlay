/*
 * Copyright 2026 Renato Mauro
 *
 * SPDX-License-Identifier: Apache-2.0
 */

auxdisplay_0: &slcd {
	slcd_panel: st_gh08172t {
		compatible = "slcd-panel";
		columns = <6>;
		rows = <1>;
		segment-type = <14>; /* 14 segment SLCD panel */

		/* Which pin controls which segment. 6 positions x 14 segments = 84 elements.
		 * Segment order per position: A B C D E F G H J K M N O P
		 * Since the display starts from left to right
		 */
		segment-pins = <
				/* Pins for dig6 segments(6A~6P) */
				10 10 10 10 11 11 11
				/* Pins for dig5 segments(5A~5P) */
				8 8 8 8 9 9 9
				/* Pins for dig4 segments(4A~4P) */
				6 6 6 6 7 7 7
				/* Pins for dig3 segments(3A~3P) */
				4 4 4 4 5 5 5
				/* Pins for dig2 segments(2A~2P) */
				2 2 2 2 3 3 3
				/* Pins for dig1 segments(1A~1P) */
				0 0 0 0 1 1 1>;

		/* Which com controls which segment. 6 positions x 7 segments = 42 elements. */
		segment-coms = <
				/* COMs for dig6 segments(6A~6P) */
				0 1 2 3 3 1 2
				/* COMs for dig5 segments(5A~5P) */
				0 1 2 3 3 1 2
				/* COMs for dig4 segments(4A~4P) */
				0 1 2 3 3 1 2
				/* COMs for dig3 segments(3A~3P) */
				0 1 2 3 3 1 2
				/* COMs for dig2 segments(2A~2P) */
				0 1 2 3 3 1 2
				/* COMs for dig1 segments(1A~1P) */
				0 1 2 3 3 1 2>;

		num-indicators = <9>;
		indicator-masks = <0x00 0x03 0x03 0x03 0x03 0x00 0x08>;
	};
};
