## drivers/auxdisplay/Kconfig.st_slcd
```kconfig
# Copyright 2026 Renato Mauro
# SPDX-License-Identifier: Apache-2.0

config AUXDISPLAY_ST_SLCD
	bool "ST MCU SLCD display driver"
	default y
	depends on DT_HAS_ST_SLCD_ENABLED
	help
	  Enable STMicroelectronics MCU SLCD (Segmented LCD) auxdisplay driver.
	  Provides the standard auxdisplay API for ST MCU SLCD hardware,
	  handling both hardware initialization and the display panel layer
	  in a single unified driver.
```

## drivers/auxdisplay/Kconfig.st_stm32_glass_lcd
```kconfig
# Copyright (c) 2026 Renato Mauro
# SPDX-License-Identifier: Apache-2.0

config AUXDISPLAY_STM32_GLASS_LCD
	bool "STM32 Internal Segment LCD (Glass) driver"
	default y
	depends on DT_HAS_ST_STM32_GLASS_LCD_ENABLED
	select HAS_MODULE_HAL_STM32
	select USE_STM32_HAL_LCD
	select USE_STM32_HAL_GPIO
	select USE_STM32_HAL_PWR
	select USE_STM32_HAL_PWR_EX
	help
	  Enable the internal Segment LCD controller driver for STM32 family
	  SoCs (e.g. STM32L4 series). This driver maps the internal hardware
	  registers to the generic Zephyr auxdisplay text interface.
```

## dts/bindings/auxdisplay/st,stm32-glass-lcd.yaml
```yaml
# Copyright (c) 2026 Your Name
# SPDX-License-Identifier: Apache-2.0

description: |
  STM32 Internal Segment LCD Controller (Glass Display Interface).
  This binding describes the internal liquid crystal display controller peripheral 
  present on STM32 microcontrollers, mapped to a 14-segment auxiliary text interface.

compatible: "st,stm32-glass-lcd"

include: [base.yaml, auxdisplay-device.yaml, pinctrl-device.yaml]

properties:
  reg:
    required: true
    description: Base address and length of the LCD peripheral register block.

  clocks:
    required: true
    description: Phandle to the clock controller and clock gating information.

  pinctrl-0:
    required: true
    description: Array of phandles to pin configuration nodes (COM/SEG lines via AF11).

  pinctrl-names:
    required: true
    const:
      - default
```
